//The code is for the movement part of the final project. the code utilzes OLED, Motors and QWIIC button as its electronic components
// The code is split into do different sections that directly match each scene in the movie UP.
// for each scene the code is uncommented and then is filmed and then commented again and then moved onto the nexr
// static OLED pictures are used for every scene where the movements is the core aspect of the scene.

// Muhammad Bin Nauman
// Performaing Robots
// Due 13/12/2020

//***************************************************************************************************************************************************************************************

#include <Arduino.h>
#include <stdint.h>
#include "SCMD.h"
#include "SCMD_config.h"                                   //Contains #defines for common SCMD register names and values
#include "Wire.h"
#include <SparkFun_Qwiic_Button.h>                          // importing all the necessary libraries 
#include <SPI.h>
#include <Wire.h>
#include "SparkFun_Qwiic_MP3_Trigger_Arduino_Library.h"

#include <Adafruit_GFX.h>
#include <Adafruit_SSD1306.h>
#define SCREEN_WIDTH 128              // OLED display width, in pixels
#define SCREEN_HEIGHT 64              // OLED display height, in pixels
#define OLED_RESET     4              // Reset pin # (or -1 if sharing Arduino reset pin)
Adafruit_SSD1306 display(SCREEN_WIDTH, SCREEN_HEIGHT, &Wire, OLED_RESET);

MP3TRIGGER mp3;
SCMD myMotorDriver;                      //This creates the main object of one motor driver and connected slaves.
QwiicButton button;                       // defining the Qwiic button

int button_state;                         // varible that allows the movements to be triggered
boolean acting;


//************************************************************************************************************************************************************************************************

const unsigned char myBitmap4 [] PROGMEM = {                                                          // OLED pictures for smiling and sad face respectivly
  0x00, 0x00, 0x00, 0x00, 0x00, 0x00, 0x00, 0x00, 0x00, 0x00, 0x00, 0x00, 0x00, 0x00, 0x00, 0x00,
  0x00, 0x00, 0x00, 0x00, 0x00, 0x00, 0x00, 0x00, 0x00, 0x00, 0x00, 0x00, 0x00, 0x00, 0x00, 0x00,
  0x00, 0x00, 0x00, 0x00, 0x00, 0x00, 0x00, 0x00, 0x00, 0x00, 0x00, 0x00, 0x00, 0x00, 0x00, 0x00,
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  0x00, 0x00, 0x00, 0x00, 0x00, 0x00, 0x00, 0x00, 0x00, 0x00, 0x00, 0x00, 0x00, 0x00, 0x00, 0x00,
};

const unsigned char myBitmap5 [] PROGMEM = {
  0x00, 0x00, 0x00, 0x00, 0x00, 0x00, 0x00, 0x00, 0x00, 0x00, 0x00, 0x00, 0x00, 0x00, 0x00, 0x00,
  0x00, 0x00, 0x00, 0x00, 0x00, 0x00, 0x00, 0x00, 0x00, 0x00, 0x00, 0x00, 0x00, 0x00, 0x00, 0x00,
  0x00, 0x00, 0x00, 0x00, 0x00, 0x00, 0x00, 0x00, 0x00, 0x00, 0x00, 0x00, 0x00, 0x00, 0x00, 0x00,
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  0x00, 0x00, 0x00, 0x00, 0x00, 0x00, 0x00, 0x00, 0x00, 0x00, 0x00, 0x00, 0x00, 0x00, 0x00, 0x00,
};

//------------------------------------------------------------------------------------------------------------------------------------------------------------------------------------------------

void setup() {
  pinMode(8, INPUT_PULLUP);                                    //Use to halt motor movement (ground)
  Serial.begin(9600);
  Serial.println("Program has started.");
  myMotorDriver.settings.commInterface = I2C_MODE;            //  .commInter face is I2C_MODE
  myMotorDriver.settings.I2CAddress = 0x5D;                   // set address if I2C configuration selected with the config jumpers config pattern is "1000" (default) on board for address 0x5D
  myMotorDriver.settings.chipSelectPin = 10;                  //  set chip select if SPI selected with the config jumpers
  Wire.begin();

  while ( myMotorDriver.begin() != 0xA9 )                     //Wait until a valid ID word is returned
  {
    Serial.println( "ID mismatch, trying again" );
    delay(500);
  }
  Serial.println( "ID matches 0xA9" );
  Serial.print("Waiting for enumeration...");                 //  Check to make sure the driver is done looking for slaves before beginning

  while ( myMotorDriver.ready() == false );

  Serial.println("Done.");
  Serial.println();

  while ( myMotorDriver.busy() );                           //Waits until the SCMD is available.
  myMotorDriver.inversionMode(1, 1);                        //invert motor 1

  while ( myMotorDriver.busy() );
  myMotorDriver.enable();                                   //Enables the output driver hardware


  if (button.begin() == false)
  {
    Serial.println("Device has not been detected! Infinite loop");          // if the button is not properly connecting than go into infinite loop
    while (1);
  }

  if (!display.begin(SSD1306_SWITCHCAPVCC, 0x3D))
  { // Address 0x3D for 128x64 and same as above but for OLED       // check to see if the OLED is connected
    Serial.println(F("SSD1306 allocation failed"));
    for (;;); // Don't proceed, loop forever
  }

  Serial.println("button is ready");
  Serial.println("OLED is ready");


  button_state = 0;                                                 // turnning the button pressed state to zero so it can be pressed to trigger movements
}

#define LEFT_MOTOR 0                                                // defining the motors
#define RIGHT_MOTOR 1


//****************************************************************************************************************************************************************

void no_button_press(void) {
  display.clearDisplay();
  display.drawBitmap(0, 0, myBitmap4, 128, 64, WHITE); //Drawing the bitmap
  display.display();
}

void loop()
{
  if (button_state == 0)
  {
    no_button_press();                                          // if the button hasent been pressed it will just display the OLED picture
  }

  if (button.isPressed() == true && button_state == 0)
  {
    button_state = 1;                                           // all the movements will occur if the button is pressed
    display.clearDisplay();                                     //for Clearing the display
    display.drawBitmap(0, 0, myBitmap4, 128, 64, WHITE);         //Drawing the bitmap
    display.display();
  }

  //-------------------------------
  if (button_state == 1)                          // The comments below is refrence the exact scene time of this video: https://www.youtube.com/watch?v=9yjAFMNkCDo&t=95s 
                                                  // or the final project video:
                                                  // all movements have a 5 second delay to get the camera ready for recording 

  {
    delay (5000);
    for (int i = 0; i < 256; i++)
    {
      myMotorDriver.setDrive( LEFT_MOTOR, 0, i);
      delay(1);
    }
    for (int i = 255; i > 0; i--)
    {
      myMotorDriver.setDrive( LEFT_MOTOR, 0, i);
      delay(1);
    }
    for (int i = 0; i < 256; i++)
    {
      myMotorDriver.setDrive( RIGHT_MOTOR, 0, i);                       // 0:08 to 0:10
      delay(1);
    }
    for (int i = 255; i > 0; i--)
    {
      myMotorDriver.setDrive( RIGHT_MOTOR, 0, i);
      delay(1);
    }

    for (int i = 0; i < 256; i++)
    {
      myMotorDriver.setDrive( LEFT_MOTOR, 0, i);
      delay(1);
    }
    for (int i = 255; i > 0; i--)
    {
      myMotorDriver.setDrive( LEFT_MOTOR, 0, i);
      delay(1);
    }
    delay(1000);
    //--------------------------------------------------------------
    delay(5000);
    for (int i = 0; i < 106; i++)
    {
      myMotorDriver.setDrive( LEFT_MOTOR, 0, i);
      myMotorDriver.setDrive( RIGHT_MOTOR, 0, i);
      delay(1);
    }
    delay(2000);
    for (int i = 105; i > 0; i--)
    {
      myMotorDriver.setDrive( LEFT_MOTOR, 0, i);
      myMotorDriver.setDrive( RIGHT_MOTOR, 0, i);
      delay(1);
    }

    for (int i = 0; i < 256; i++)
    {
      myMotorDriver.setDrive( LEFT_MOTOR, 0, i);              //0:12 to 0:15
      delay(1);
    }
    delay(200);
    for (int i = 255; i > 0; i--)
    {
      myMotorDriver.setDrive( LEFT_MOTOR, 0, i);
      delay(1);
    }
    for (int i = 0; i < 106; i++)
    {
      myMotorDriver.setDrive( LEFT_MOTOR, 0, i);
      myMotorDriver.setDrive( RIGHT_MOTOR, 0, i);
      delay(1);
    }
    delay(2000);
    for (int i = 105; i > 0; i--)
    {
      myMotorDriver.setDrive( LEFT_MOTOR, 0, i);
      myMotorDriver.setDrive( RIGHT_MOTOR, 0, i);
      delay(1);
    }
    //-----------------------------------------------------------
    delay(5000);
    for (int k = 0; k < 5; k++)
    {
      for (int i = 0; i < 256; i++)
      {
        myMotorDriver.setDrive( LEFT_MOTOR, 1, i);
        myMotorDriver.setDrive( RIGHT_MOTOR, 0, i);
        delay(1);
      }
      for (int i = 255; i > 0; i--)
      {
        myMotorDriver.setDrive( LEFT_MOTOR, 1, i);
        myMotorDriver.setDrive( RIGHT_MOTOR, 0, i);               // 0:18 to 0:23
        delay(1);
      }
      for (int i = 0; i < 256; i++)
      {
        myMotorDriver.setDrive( RIGHT_MOTOR, 1, i);
        myMotorDriver.setDrive( LEFT_MOTOR, 0, i);
        delay(1);
      }
      for (int i = 255; i > 0; i--)
      {
        myMotorDriver.setDrive( RIGHT_MOTOR, 1, i);
        myMotorDriver.setDrive( LEFT_MOTOR, 0, i);
        delay(1);
      }
    }
    //---------------------------------------------------------
    delay(5000);
    for (int i = 0; i < 106; i++)
    {
      myMotorDriver.setDrive( LEFT_MOTOR, 0, i);
      myMotorDriver.setDrive( RIGHT_MOTOR, 0, i);
      delay(1);
    }
    delay(2000);
    for (int i = 105; i > 0; i--)
    {
      myMotorDriver.setDrive( LEFT_MOTOR, 0, i);
      myMotorDriver.setDrive( RIGHT_MOTOR, 0, i);           // 0:23 to 0:26
      delay(1);
    }

    for (int i = 0; i < 256; i++)
    {
      myMotorDriver.setDrive( RIGHT_MOTOR, 0, i);
      delay(1);
    }
    delay(200);
    for (int i = 255; i > 0; i--)
    {
      myMotorDriver.setDrive( RIGHT_MOTOR, 0, i);
      delay(1);
    }

    //--------------------------------------------------------
    delay(5000);
    display.clearDisplay();                             
    display.drawBitmap(0, 0, myBitmap5, 128, 64, WHITE); 
    display.display();
    for (int k = 0; k < 3; k++) {
      for (int i = 0; i < 256; i++)
      {
        myMotorDriver.setDrive( LEFT_MOTOR, 0, i);
      }
      for (int i = 255; i > 0; i--)
      {
        myMotorDriver.setDrive( LEFT_MOTOR, 0, i);                                // 0:26 to 0:30
      }
      for (int i = 0; i < 256; i++)
      {
        myMotorDriver.setDrive( RIGHT_MOTOR, 0, i);
      }
      for (int i = 255; i > 0; i--)
      {
        myMotorDriver.setDrive( RIGHT_MOTOR, 0, i);
      }
    }
    delay(1000);
    display.clearDisplay();                            
    display.drawBitmap(0, 0, myBitmap4, 128, 64, WHITE); 
    display.display();
    //---------------------------------------------------------
    delay(5000);
    for (int i = 0; i < 106; i++)
    {
      myMotorDriver.setDrive( LEFT_MOTOR, 0, i);
      myMotorDriver.setDrive( RIGHT_MOTOR, 0, i);
      delay(1);
    }
    delay(2000);                                                                // 0:34 to 0:38
    for (int i = 105; i > 0; i--)
    {
      myMotorDriver.setDrive( LEFT_MOTOR, 0, i);
      myMotorDriver.setDrive( RIGHT_MOTOR, 0, i);
      delay(25);
    }

    //-----------------------------------------------------------
    delay(5000);
    for (int i = 0; i < 256; i++)
    {
      myMotorDriver.setDrive( LEFT_MOTOR, 0, i);
      delay(1);
    }
    delay(1000);
    for (int i = 255; i > 0; i--)
    {
      myMotorDriver.setDrive( LEFT_MOTOR, 0, i);
      delay(1);
    }
    for (int i = 0; i < 256; i++)
    {
      myMotorDriver.setDrive( LEFT_MOTOR, 0, i);
      myMotorDriver.setDrive( RIGHT_MOTOR, 0, i);
      delay(1);
    }
    delay(1);
    for (int i = 255; i > 0; i--)
    {
      myMotorDriver.setDrive( LEFT_MOTOR, 0, i);
      myMotorDriver.setDrive( RIGHT_MOTOR, 0, i);                   // 0:48 to 0:55
      delay(1);
    }
    delay(1000);
    for (int i = 0; i < 256; i++)
    {
      myMotorDriver.setDrive( RIGHT_MOTOR, 0, i);
      delay(1);
    }
    delay(400);
    for (int i = 255; i > 0; i--)
    {
      myMotorDriver.setDrive( RIGHT_MOTOR, 0, i);
      delay(1);
    }
    for (int i = 0; i < 255; i++)
    {
      myMotorDriver.setDrive( LEFT_MOTOR, 0, i);
      myMotorDriver.setDrive( RIGHT_MOTOR, 0, i);
      delay(1);
    }
    delay(1);
    for (int i = 254; i > 0; i--)
    {
      myMotorDriver.setDrive( LEFT_MOTOR, 0, i);
      myMotorDriver.setDrive( RIGHT_MOTOR, 0, i);
      delay(1);
    }
    //-----------------------------------------------------
    delay(5000);
    for (int k = 0; k < 2; k++) {
      for (int i = 0; i < 256; i++)
      {
        myMotorDriver.setDrive( LEFT_MOTOR, 0, i);
      }
      for (int i = 255; i > 0; i--)
      {
        myMotorDriver.setDrive( LEFT_MOTOR, 0, i);              // 0:55 to 1:00
      }
      for (int i = 0; i < 256; i++)
      {
        myMotorDriver.setDrive( RIGHT_MOTOR, 0, i);
      }
      for (int i = 255; i > 0; i--)
      {
        myMotorDriver.setDrive( RIGHT_MOTOR, 0, i);
      }
      delay(100);
    }
    //-----------------------------------------------------
    delay(5000);
    for (int i = 0; i < 56; i++)
    {
      myMotorDriver.setDrive( LEFT_MOTOR, 0, i);
      myMotorDriver.setDrive( RIGHT_MOTOR, 0, i);
      delay(1);
    }
    delay(2000);
    for (int i = 55; i > 0; i--)
    {
      myMotorDriver.setDrive( LEFT_MOTOR, 0, i);
      myMotorDriver.setDrive( RIGHT_MOTOR, 0, i);           // 1:21 to 1:23
      delay(1);
    }
    for (int i = 0; i < 156; i++)
    {
      myMotorDriver.setDrive( RIGHT_MOTOR, 0, i);
      delay(1);
    }
    delay(500);
    for (int i = 155; i > 0; i--)
    {
      myMotorDriver.setDrive( RIGHT_MOTOR, 0, i);
      delay(1);
    }
    //-----------------------------------------------------
    for (int i = 0; i < 156; i++)
    {
      myMotorDriver.setDrive( RIGHT_MOTOR, 0, i);
      delay(1);
    }
    delay(1000);
    for (int i = 155; i > 0; i--)                                        // 1:33 to 1:36
    {
      myMotorDriver.setDrive( RIGHT_MOTOR, 0, i);
      delay(1);
    }
    //-----------------------------------------------------
    for (int i = 0; i < 156; i++)
    {
      myMotorDriver.setDrive( LEFT_MOTOR, 0, i);
      myMotorDriver.setDrive( RIGHT_MOTOR, 0, i);
      delay(1);
    }
    delay(1000);
    for (int i = 155; i > 0; i--)                                // 2:04 to 2:07
    {
      myMotorDriver.setDrive( LEFT_MOTOR, 0, i);
      myMotorDriver.setDrive( RIGHT_MOTOR, 0, i);
      delay(1);
    }
    //---------------------------------------------------
    for (int i = 0; i < 156; i++)
    {
      myMotorDriver.setDrive( RIGHT_MOTOR, 0, i);
      delay(1);
    }
    delay(1000);
    for (int i = 155; i > 0; i--)                             // 2:42 to 2:44
                                                              // 3:43 to 3:51
    {
      myMotorDriver.setDrive( RIGHT_MOTOR, 0, i);
      delay(1);
    }
    //-----------------------------------------------------
    delay(5000);
    for (int k = 0; k < 10; k++)
    {
      for (int i = 0; i < 256; i++)
      {
        myMotorDriver.setDrive( LEFT_MOTOR, 1, i / 2);
        myMotorDriver.setDrive( RIGHT_MOTOR, 0, i);             // 2:47 to 2:54
        delay(1);
      }
      for (int i = 255; i > 0; i--)
      {
        myMotorDriver.setDrive( LEFT_MOTOR, 1, i / 2);
        myMotorDriver.setDrive( RIGHT_MOTOR, 0, i);
        delay(1);
      }
    }
    //---------------------------------------------------------
    delay(5000);
    for (int k = 0; k < 2; k++) {
      for (int i = 0; i < 256; i++)
      {
        myMotorDriver.setDrive( LEFT_MOTOR, 0, i);
      }
      for (int i = 255; i > 0; i--)
      {
        myMotorDriver.setDrive( LEFT_MOTOR, 0, i);
      }
      for (int i = 0; i < 256; i++)
      {
        myMotorDriver.setDrive( RIGHT_MOTOR, 0, i);
      }
      for (int i = 255; i > 0; i--)
      {
        myMotorDriver.setDrive( RIGHT_MOTOR, 0, i);                   // 3:16 to 3:23
      }
      delay(100);
    }
    delay(2000);
    for (int i = 0; i < 206; i++)
    {
      myMotorDriver.setDrive( LEFT_MOTOR, 0, i);
      myMotorDriver.setDrive( RIGHT_MOTOR, 0, i);
      delay(1);
    }
    delay(1000);
    for (int i = 205; i > 0; i--)
    {
      myMotorDriver.setDrive( LEFT_MOTOR, 0, i);
      myMotorDriver.setDrive( RIGHT_MOTOR, 0, i);
      delay(1);
    }
    //---------------------------------------------------------
    delay(5000);
    for (int i = 0; i < 56; i++)
    {
      myMotorDriver.setDrive( LEFT_MOTOR, 0, i);
      myMotorDriver.setDrive( RIGHT_MOTOR, 0, i);
      delay(1);
    }
    delay(5000);
    for (int i = 55; i > 0; i--)                              // 4:13 to 4:20
    {
      myMotorDriver.setDrive( LEFT_MOTOR, 0, i);
      myMotorDriver.setDrive( RIGHT_MOTOR, 0, i);
      delay(1);
    }
  }
  button_state = 0;                                       // reset the button state to zero when the movements is finished
}
